VERSION "0.0.1"

NS_ :

BS_:

BU_: UnusedNode

BO_ 123456789 MultiplexerTest: 1 fake_device
 SG_ MuxSelector M : 0|2@1+ (1,0) [0|3] "selector" Vector__XXX
 SG_ Muxed1 m0 : 2|6@1+ (1,0) [0|63] "bits" Vector__XXX
 SG_ Muxed2 m1 : 2|6@1+ (1,0) [0|63] "bits" Vector__XXX
 SG_ Muxed3 m2 : 2|6@1+ (1,0) [0|63] "bits" Vector__XXX
 SG_ Muxed4 m3 : 2|6@1+ (1,0) [0|63] "bits" Vector__XXX
